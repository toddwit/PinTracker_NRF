## pintracker_app/build_anchor_0/pintracker_app/Kconfig/boards/Kconfig.defconfig
```kconfig
# Load Zephyr board defconfig descriptions.
osource "C:/ncs/v3.3.0/zephyr/boards/qorvo/decawave_dwm3001cdk/Kconfig.defconfig"
```

## pintracker_app/build_anchor_0/pintracker_app/Kconfig/boards/Kconfig.sysbuild.tmp
```kconfig
# Load Sysbuild board Kconfig descriptions.
osource "C:/ncs/v3.3.0/zephyr/boards/qorvo/decawave_dwm3001cdk/Kconfig.sysbuild"
```
